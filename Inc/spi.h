/**
 ******************************************************************************
 * File Name          : SPI.h
 * Description        : This file provides code for the configuration
 *                      of the SPI instances.
 ******************************************************************************
 ** This notice applies to any and all portions of this file
 * that are not between comment pairs USER CODE BEGIN and
 * USER CODE END. Other portions of this file, whether
 * inserted by the user or by software development tools
 * are owned by their respective copyright owners.
 *
 * COPYRIGHT(c) 2017 STMicroelectronics
 *
 * Redistribution and use in source and binary forms, with or without modification,
 * are permitted provided that the following conditions are met:
 *   1. Redistributions of source code must retain the above copyright notice,
 *      this list of conditions and the following disclaimer.
 *   2. Redistributions in binary form must reproduce the above copyright notice,
 *      this list of conditions and the following disclaimer in the documentation
 *      and/or other materials provided with the distribution.
 *   3. Neither the name of STMicroelectronics nor the names of its contributors
 *      may be used to endorse or promote products derived from this software
 *      without specific prior written permission.
 *
 * THIS SOFTWARE IS PROVIDED BY THE COPYRIGHT HOLDERS AND CONTRIBUTORS "AS IS"
 * AND ANY EXPRESS OR IMPLIED WARRANTIES, INCLUDING, BUT NOT LIMITED TO, THE
 * IMPLIED WARRANTIES OF MERCHANTABILITY AND FITNESS FOR A PARTICULAR PURPOSE ARE
 * DISCLAIMED. IN NO EVENT SHALL THE COPYRIGHT HOLDER OR CONTRIBUTORS BE LIABLE
 * FOR ANY DIRECT, INDIRECT, INCIDENTAL, SPECIAL, EXEMPLARY, OR CONSEQUENTIAL
 * DAMAGES (INCLUDING, BUT NOT LIMITED TO, PROCUREMENT OF SUBSTITUTE GOODS OR
 * SERVICES; LOSS OF USE, DATA, OR PROFITS; OR BUSINESS INTERRUPTION) HOWEVER
 * CAUSED AND ON ANY THEORY OF LIABILITY, WHETHER IN CONTRACT, STRICT LIABILITY,
 * OR TORT (INCLUDING NEGLIGENCE OR OTHERWISE) ARISING IN ANY WAY OUT OF THE USE
 * OF THIS SOFTWARE, EVEN IF ADVISED OF THE POSSIBILITY OF SUCH DAMAGE.
 *
 ******************************************************************************
 */
/* Define to prevent recursive inclusion -------------------------------------*/
#ifndef __spi_H
#define __spi_H
#ifdef __cplusplus
extern "C" {
#endif

/* Includes ------------------------------------------------------------------*/
#include "stm32f7xx_hal.h"
#include "main.h"

/* USER CODE BEGIN Includes */

/* USER CODE END Includes */

extern SPI_HandleTypeDef hspi5;

/* USER CODE BEGIN Private defines */

/* USER CODE END Private defines */

extern void _Error_Handler(char *, int);

void MX_SPI5_Init(void);

/* USER CODE BEGIN Prototypes */
/*nkessa code for NFRFID reader*/

#ifndef bool
#define bool int
#endif

#ifndef true
#define true 1
#endif


#ifndef false
#define false  0
#endif

#define BIT0 1
#define BIT1 2
#define BIT2 4
#define BIT3 8
#define BIT4 16
#define BIT5 32
#define BIT6 64
#define BIT7 128

#ifndef STATUS_FAIL
#define	STATUS_FAIL			0x00
#endif

#ifndef STATUS_SUCCESS
#define STATUS_SUCCESS		0x01
#endif

//delay in mS
#define MCU_delayMillisecond HAL_Delay


//definition of LED ons and offs for visual indications
#define LED_14443B_ON  log_message("LED_14443B_ON---------------------------------\n\r")// do {} while (0) //noOp for now
#define LED_14443B_OFF log_message("LED_14443B_OFF\n\r")//  do {} while (0) //noOp for now
#define LED_14443A_OFF log_message("LED_14443A_OFF\n\r")//do {} while (0) //noOp for now
#define LED_15693_OFF log_message("LED_15693_OFF\n\r")//do {} while (0) //noOp for now
#define LED_15693_ON log_message("LED_15693_ON------------------------------------\n\r")//do {} while (0) //noOp for now
#define LED_14443A_ON log_message("LED_14443A_ON-----------------------------------n\r")//do {} while (0) //noOp for now
#define LED_ALL_OFF log_message("LED_ALL_OFF\n\r")//do {} while (0) //noOp for now
#define LED_PORT_SET log_message("LED_PORT_SET\n\r")//do {} while (0) //noOp for now

//enable interrupts from the NFRFID chip
#define IRQ_ON   HAL_NVIC_SetPriority(EXTI9_5_IRQn,1,1); HAL_NVIC_EnableIRQ(EXTI9_5_IRQn);

//clear interrupt flags generated by the NFRFID chip
#define IRQ_CLR __HAL_GPIO_EXTI_CLEAR_FLAG(GPIO_PIN_6); \
		__HAL_GPIO_EXTI_CLEAR_IT(GPIO_PIN_6);\
		log_message("IRQ_CLR\n\r")

//set the enable pin on the NFRFID chip high to enable the chip
#define TRF_ENABLE_SET  HAL_GPIO_WritePin(GPIOI, GPIO_PIN_2, GPIO_PIN_SET); \
		log_message("TRF_ENABLE_SET\n\r")

#define TRF_ENABLE  HAL_GPIO_WritePin(GPIOI, GPIO_PIN_2, GPIO_PIN_SET);

//reset the enable pin on the NFRFID chip high to disable the chip
#define TRF_DISABLE  HAL_GPIO_WritePin(GPIOI, GPIO_PIN_2, GPIO_PIN_RESET);

#define IRQ_PIN_SET  log_message("IRQ_PIN_SET\n\r")
#define IRQ_EDGE_SET 	log_message("IRQ_EDGE_SET\n\r")		// rising edge interrupt


/*------------------- counter stuff -----------*/
extern volatile uint32_t NFRFID_timer_settings_ms ;
extern volatile uint32_t NFRFID_timer_running ;
#define COUNTER_VALUE	1600				//VALUE 16 mS
#define START_COUNTER	MCU_setCounter(COUNTER_VALUE)			//start counter in up mode
#define STOP_COUNTER	NFRFID_timer_running=0	//stops the counter
#define RESET_COUNTER   NFRFID_timer_settings_ms=0    	//Resets and stops counter.
/* ----------end counter stuff--------------------*/

/*-----------------logging to the UART stuff--------------*/
extern void log_message(char * buff);
extern void log_byte(uint8_t data);
extern void log_byte_decimal(uint8_t data);
extern void log_char( char c);

#define ENABLE_HOST   //Undefined this to stop the program from printing to UART
#ifndef UART_putNewLine()
#define UART_putNewLine()  log_message("\n\r")
#endif

#ifndef UART_putChar(x)
#define UART_putChar(x) log_char(x)
#endif

#ifndef UART_sendCString(x)
#define UART_sendCString(x) log_message(x)
#endif
#ifndef UART_putByte(x)
#define UART_putByte(x) log_byte(x)
#endif

#ifndef UART_putByteDecimalValue(x)
#define UART_putByteDecimalValue(x) log_byte_decimal(x)
#endif
/*----------------- end logging to the UART stuff--------------*/


/*----------------- Chip select stuff -----------------*/
#define NFRFID_WRITE_READ_TIME_OUT_MS 20
#define NFRFID_CHIP_SELECT_PIN GPIO_PIN_10
#define NFRFID_CHIP_SELECT_PORT  GPIOF
#define SLAVE_SELECT_LOW HAL_GPIO_WritePin(NFRFID_CHIP_SELECT_PORT ,NFRFID_CHIP_SELECT_PIN, GPIO_PIN_RESET)
#define SLAVE_SELECT_HIGH  HAL_GPIO_WritePin(NFRFID_CHIP_SELECT_PORT ,NFRFID_CHIP_SELECT_PIN, GPIO_PIN_SET)
/*----------------- End chip select stuff ------------*/


//delay in microseconds
void delay_us(const uint16_t us);

//low level SPI write/read
void SPI_directCommand(uint8_t ui8Command);
void SPI_directMode(void);
void SPI_rawWrite(uint8_t * pui8Buffer, uint8_t ui8Length, bool bContinuedSend);
void SPI_readCont(uint8_t * pui8Buffer, uint8_t ui8Length);
void SPI_readSingle(uint8_t * pui8Buffer);
uint8_t SPI_receiveByte(void);
void SPI_sendByte(uint8_t ui8TxByte);
void SPI_usciSet(void);
void SPI_writeCont(uint8_t * pui8Buffer, uint8_t ui8Length);
void SPI_writeSingle(uint8_t * pui8Buffer);
void SPI_setup(void);


/* USER CODE END Prototypes */

#ifdef __cplusplus
}
#endif
#endif /*__ spi_H */

/**
 * @}
 */

/**
 * @}
 */

/************************ (C) COPYRIGHT STMicroelectronics *****END OF FILE****/
